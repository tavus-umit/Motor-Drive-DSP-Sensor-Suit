/**
 * @cliArgs --device "F2838x" --part "F2838x_337bga" --package "337bga" --context "CPU1" --product "C2000WARE@5.05.00.00"
 * @versions {"tool":"1.24.0+4110"}
 */

/**
 * Import the modules used in this configuration.
 */
const i2c  = scripting.addModule("/driverlib/i2c.js", {}, false);
const i2c1 = i2c.addInstance();

/**
 * Write custom configuration values to the imported modules.
 */
i2c1.$name         = "myI2C0";
i2c1.useFifo       = false;
i2c1.useInterrupts = false;

/**
 * Pinmux solution for unlocked pins/peripherals. This ensures that minor changes to the automatic solver in a future
 * version of the tool will not impact the pinmux you originally saw.  These lines can be completely deleted in order to
 * re-solve from scratch.
 */
i2c1.i2c.$suggestSolution            = "I2CB";
i2c1.i2c.i2c_sdaPin.$suggestSolution = "GPIO2";
i2c1.i2c.i2c_sclPin.$suggestSolution = "GPIO3";
